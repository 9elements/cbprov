## test/fixtures/configs/aarch64.defconfig
```kconfig
# payload-arch: arm64
CONFIG_VENDOR_EMULATION=y
CONFIG_BOARD_EMULATION_QEMU_AARCH64=y
CONFIG_VPD=y
# CONFIG_PAYLOAD_NONE is not set
CONFIG_PAYLOAD_ELF=y
CONFIG_PAYLOAD_FILE="@PAYLOAD@"
CONFIG_FMDFILE="@FMD@"
```

## test/fixtures/configs/i440fx.defconfig
```kconfig
# payload-arch: x86
CONFIG_VENDOR_EMULATION=y
CONFIG_BOARD_EMULATION_QEMU_X86_I440FX=y
CONFIG_VPD=y
CONFIG_SMBIOS_SERIAL_FROM_VPD=y
CONFIG_SMBIOS_UUID_FROM_VPD=y
CONFIG_SMBIOS_SYSTEM_DATA_FROM_VPD=y
CONFIG_PAYLOAD_ELF=y
CONFIG_PAYLOAD_FILE="@PAYLOAD@"
```

## test/fixtures/configs/q35-cbfsverify.defconfig
```kconfig
# payload-arch: x86
CONFIG_VENDOR_EMULATION=y
CONFIG_BOARD_EMULATION_QEMU_X86_Q35=y
CONFIG_VPD=y
CONFIG_SMBIOS_SERIAL_FROM_VPD=y
CONFIG_SMBIOS_UUID_FROM_VPD=y
CONFIG_SMBIOS_SYSTEM_DATA_FROM_VPD=y
CONFIG_SMMSTORE=y
CONFIG_DRIVERS_EFI_VARIABLE_STORE=y
CONFIG_USE_UEFI_VARIABLE_STORE=y
CONFIG_DRIVERS_OPTION_CFR=y
CONFIG_CBFS_VERIFICATION=y
CONFIG_PAYLOAD_ELF=y
CONFIG_PAYLOAD_FILE="@PAYLOAD@"
```

## test/fixtures/configs/q35-vboot.defconfig
```kconfig
# payload-arch: x86
CONFIG_VENDOR_EMULATION=y
CONFIG_BOARD_EMULATION_QEMU_X86_Q35=y
CONFIG_VBOOT=y
CONFIG_VBOOT_SLOTS_RW_AB=y
CONFIG_VBOOT_MOCK_SECDATA=y
CONFIG_VPD=y
CONFIG_SMBIOS_SERIAL_FROM_VPD=y
CONFIG_SMBIOS_UUID_FROM_VPD=y
CONFIG_SMBIOS_SYSTEM_DATA_FROM_VPD=y
CONFIG_PAYLOAD_ELF=y
CONFIG_PAYLOAD_FILE="@PAYLOAD@"
```
